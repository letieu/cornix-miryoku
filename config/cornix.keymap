// Miryoku on the Cornix (jzf/cornix ZMK boards) — ZMK + Miryoku layout.
//
//   Physical mapping: config/includes/miryoku_cornix.h
//   Layer contents:   config/includes/miryoku_keys_generated.h (from the .vil)
//
// This keymap owns the `keymap` node itself instead of including miryoku_zmk's
// `miryoku.dtsi`: Miryoku's node has no `sensor-bindings`, which is why the
// rotary encoders do nothing. Everything else (behaviors, pointing, bluetooth)
// comes from ZMK directly, so the file is self-contained.

// ---------------------------------------------------------------------------
// Pointer speed. ZMK takes the *speed ceiling* from the binding parameter
// (`MOVE_UP` is `MOVE_Y(-ZMK_POINTING_DEFAULT_MOVE_VAL)`) and ramps from 0 up
// to it, so the only real knob is these two macros - they must be defined
// before <dt-bindings/zmk/pointing.h> is pulled in below.
//
// Upstream's default is 600 px/s, and that is all this build had: the 1250 in
// the older docs came from miryoku_zmk, which config/west.yml no longer pulls
// in. 600 px/s is ~4x slower than a real mouse, which is why pointing felt
// sluggish. 2400 px/s (4x upstream) with a 200 ms ramp: a 60 ms tap still only
// travels ~100 px (fine aiming), a longer hold ends up at full speed.
#define ZMK_POINTING_DEFAULT_MOVE_VAL 2400
//
// Scroll is a *rate*, not a step: `&msc` emits SCRL_VAL * trigger-period-ms /
// 1000 wheel detents per tick (16 ms) and carries the fraction to the next
// tick. Upstream's 10 therefore means "one notch every 100 ms" - and any tap
// shorter than 100 ms scrolls nothing at all. That is exactly the "slow and
// laggy" MOUSE layer: ~10 notches/s at best, in 100 ms lumps.
//
//   10 -> 1 notch / 100 ms (upstream, unusable)   40 -> 1 notch / 25 ms
//   20 -> 1 notch / 50 ms                         80 -> 1 notch / 12 ms
//
// 40 keeps a short tap worth a full notch while a held key reaches ~40
// notches/s (~2000 px/s at macOS's default 3 lines per notch).
#define ZMK_POINTING_DEFAULT_SCRL_VAL 40

#include <behaviors.dtsi>
#include <behaviors/mouse_keys.dtsi>
#include <dt-bindings/zmk/keys.h>
#include <dt-bindings/zmk/bt.h>
#include <dt-bindings/zmk/outputs.h>
#include <dt-bindings/zmk/pointing.h>
#include <behaviors/rgbled_widget.dtsi>   // &ind_bat / &ind_con

#include "includes/miryoku_cornix.h"
#include "includes/miryoku_keys_generated.h"

// Two-step expansion: MIRYOKU_LAYER_<NAME> is itself a macro holding the 54
// bindings, and it has to be expanded *before* the mapping macro collects its
// arguments (same trick miryoku_zmk uses).
#define U_EXPAND(macro, ...) macro(__VA_ARGS__)

// Encoders, matching the .vil's encoder mapping:
//   left  knob: clockwise = volume down, counter-clockwise = volume up
//   right knob: clockwise = scroll up,   counter-clockwise = scroll down
#define SENSOR_BINDINGS \
  sensor-bindings = <&inc_dec_kp C_VOL_DN C_VOL_UP>, <&enc_scroll SCRL_UP SCRL_DOWN>;

/ {
  behaviors {
    // "Timeless" home-row mods (urob's configuration). Positional hold-tap:
    // a same-hand roll can never resolve as a modifier.
    // Keymap positions: 0-11 top row, 12-23 home row, 24-37 bottom row + the two
    // inner keys (30, 31), 38-40 left palms, 41-43 left thumbs, 44-46 right
    // thumbs, 47-49 right palms.
#define KEYS_L 0 1 2 3 4 5 12 13 14 15 16 17 24 25 26 27 28 29 30 38 39 40
#define KEYS_R 6 7 8 9 10 11 18 19 20 21 22 23 31 32 33 34 35 36 37 47 48 49
#define THUMBS 41 42 43 44 45 46

    hml: hml {
      compatible = "zmk,behavior-hold-tap";
      #binding-cells = <2>;
      flavor = "balanced";
      tapping-term-ms = <280>;
      quick-tap-ms = <175>;
      require-prior-idle-ms = <150>;
      bindings = <&kp>, <&kp>;
      hold-trigger-key-positions = <KEYS_R THUMBS>;
      hold-trigger-on-release;
    };
    hmr: hmr {
      compatible = "zmk,behavior-hold-tap";
      #binding-cells = <2>;
      flavor = "balanced";
      tapping-term-ms = <280>;
      quick-tap-ms = <175>;
      require-prior-idle-ms = <150>;
      bindings = <&kp>, <&kp>;
      hold-trigger-key-positions = <KEYS_L THUMBS>;
      hold-trigger-on-release;
    };

    // Right encoder drives the mouse wheel: two &msc bindings, one cell each.
    enc_scroll: enc_scroll {
      compatible = "zmk,behavior-sensor-rotate-var";
      #sensor-binding-cells = <2>;
      bindings = <&msc>, <&msc>;
    };
  };

  keymap {
    compatible = "zmk,keymap";

    base {
      display-name = "BASE";
      bindings = <U_EXPAND(MIRYOKU_LAYOUTMAPPING_CORNIX, MIRYOKU_LAYER_BASE)>;
      SENSOR_BINDINGS
    };
    extra {
      display-name = "EXTRA";
      bindings = <U_EXPAND(MIRYOKU_LAYOUTMAPPING_CORNIX, MIRYOKU_LAYER_EXTRA)>;
      SENSOR_BINDINGS
    };
    tap {
      display-name = "TAP";
      bindings = <U_EXPAND(MIRYOKU_LAYOUTMAPPING_CORNIX, MIRYOKU_LAYER_TAP)>;
      SENSOR_BINDINGS
    };
    button {
      display-name = "BUTTON";
      bindings = <U_EXPAND(MIRYOKU_LAYOUTMAPPING_CORNIX, MIRYOKU_LAYER_BUTTON)>;
      SENSOR_BINDINGS
    };
    nav {
      display-name = "NAV";
      bindings = <U_EXPAND(MIRYOKU_LAYOUTMAPPING_CORNIX, MIRYOKU_LAYER_NAV)>;
      SENSOR_BINDINGS
    };
    mouse {
      display-name = "MOUSE";
      bindings = <U_EXPAND(MIRYOKU_LAYOUTMAPPING_CORNIX, MIRYOKU_LAYER_MOUSE)>;
      SENSOR_BINDINGS
    };
    media {
      display-name = "MEDIA";
      bindings = <U_EXPAND(MIRYOKU_LAYOUTMAPPING_CORNIX, MIRYOKU_LAYER_MEDIA)>;
      SENSOR_BINDINGS
    };
    num {
      display-name = "NUM";
      bindings = <U_EXPAND(MIRYOKU_LAYOUTMAPPING_CORNIX, MIRYOKU_LAYER_NUM)>;
      SENSOR_BINDINGS
    };
    sym {
      display-name = "SYM";
      bindings = <U_EXPAND(MIRYOKU_LAYOUTMAPPING_CORNIX, MIRYOKU_LAYER_SYM)>;
      SENSOR_BINDINGS
    };
    fun {
      display-name = "FUN";
      bindings = <U_EXPAND(MIRYOKU_LAYOUTMAPPING_CORNIX, MIRYOKU_LAYER_FUN)>;
      SENSOR_BINDINGS
    };
  };
};

// Layer-taps (thumbs): Miryoku's tap-preferred behaviour with the .vil timings.
// A thumb-held layer should not be gated by the opposite-hand rule, so this is
// separate from &hml / &hmr.
&lt {
  tapping-term-ms = <200>;
  quick-tap-ms = <150>;
  require-prior-idle-ms = <150>;
};

// Pointer feel: linear ramp to full speed in 200 ms, one report every 8 ms
// (~125 Hz), no start delay. `acceleration-exponent = 0` would give constant
// speed (predictable but coarse); keep 1 so short taps stay slow/accurate.
&mmv {
  acceleration-exponent = <1>;
  time-to-max-speed-ms = <200>;
  delay-ms = <0>;
  trigger-period-ms = <8>;
};

// Wheel feel: exponent 0 keeps the speed constant, so the very first tick
// already carries SCRL_VAL/62.5 of a notch instead of starting from zero -
// with an acceleration ramp the first ~100 ms of a press would stay below one
// detent and the scroll would feel dead. 16 ms ticks (the &msc default) are
// plenty: macOS smooths discrete wheel notches itself.
&msc {
  acceleration-exponent = <0>;
  time-to-max-speed-ms = <0>;
  delay-ms = <0>;
  trigger-period-ms = <16>;
};
